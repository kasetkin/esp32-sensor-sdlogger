## test_app/sdkconfig.defaults
```kconfig
CONFIG_COMPILER_OPTIMIZATION_PERF=y
CONFIG_FATFS_VFS_FSTAT_BLKSIZE=4096
CONFIG_BT_ENABLED=y
CONFIG_BT_NIMBLE_NVS_PERSIST=y
CONFIG_BTDM_CTRL_MODE_BLE_ONLY=y
CONFIG_BTDM_CTRL_MODE_BR_EDR_ONLY=n
CONFIG_BTDM_CTRL_MODE_BTDM=n
CONFIG_BT_BLUEDROID_ENABLED=n
CONFIG_BT_NIMBLE_ENABLED=y
CONFIG_ESP_MAIN_TASK_STACK_SIZE=8192
```
